## CMakeLists.txt
```
# SPDX-License-Identifier: Apache-2.0

cmake_minimum_required(VERSION 3.20.0)
find_package(Zephyr REQUIRED HINTS $ENV{ZEPHYR_BASE})

project(thingset_protocol_test)

FILE(GLOB app_sources src/*.cpp)
target_sources(app PRIVATE ${app_sources})

# only include, don't compile c files for cpp tests
zephyr_include_directories(../common)
```

## prj.conf
```kconfig
# Copyright (c) The ThingSet Project Contributors
# SPDX-License-Identifier: Apache-2.0

CONFIG_THINGSET=y

# enable all optional features to increase test coverage
CONFIG_THINGSET_64BIT_TYPES_SUPPORT=y
CONFIG_THINGSET_DECFRAC_TYPE_SUPPORT=y
CONFIG_THINGSET_BYTES_TYPE_SUPPORT=y

CONFIG_ZTEST=y
CONFIG_ZTEST_SUMMARY=n

# enable colored output (see tc_util_user_override.h)
CONFIG_ZTEST_TC_UTIL_USER_OVERRIDE=y

# enable click-able absolute paths in assert messages
CONFIG_BUILD_OUTPUT_STRIP_PATHS=n
```

## src/init.cpp
```c
/*
 * Copyright (c) The ThingSet Project Contributors
 *
 * SPDX-License-Identifier: Apache-2.0
 */

#include <zephyr/ztest.h>

#include <thingset.h>

#include "../../src/thingset_internal.h"

/* use same test data as for standard test, but compile with g++ */
#include "data.c"

ZTEST(thingset_init_cpp, test_init_data_objects)
{
    struct thingset_global_context ts_local;
    struct thingset_global_context ts_global;

    /* initialized with array declared in data.c */
    thingset_init(&ts_local, data_objects, data_objects_size);

    /* initialized using Zephyr iterable sections */
    thingset_init_global(&ts_global);

    zassert_equal(ts_local.num_objects, data_objects_size);
    zassert_equal(ts_global.num_objects, data_objects_size);

    zassert_mem_equal(ts_local.data_objects, ts_global.data_objects,
                      data_objects_size * sizeof(struct thingset_data_object));
}

ZTEST_SUITE(thingset_init_cpp, NULL, NULL, NULL, NULL, NULL);
```
