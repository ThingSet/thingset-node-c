## CMakeLists.txt
```
# SPDX-License-Identifier: Apache-2.0

cmake_minimum_required(VERSION 3.20.0)
find_package(Zephyr REQUIRED HINTS $ENV{ZEPHYR_BASE})

project(thingset_protocol_test)

FILE(GLOB app_sources src/*.c)
target_sources(app PRIVATE ${app_sources})

add_subdirectory(../common test_common)
```

## prj.conf
```kconfig
# Copyright (c) The ThingSet Project Contributors
# SPDX-License-Identifier: Apache-2.0

CONFIG_THINGSET=y

# enable all optional features to increase test coverage
CONFIG_THINGSET_64BIT_TYPES_SUPPORT=y
CONFIG_THINGSET_DECFRAC_TYPE_SUPPORT=y
CONFIG_THINGSET_BYTES_TYPE_SUPPORT=y
CONFIG_THINGSET_JSON_STRING_ESCAPING=y
CONFIG_THINGSET_METADATA_ENDPOINT=y

CONFIG_ZTEST=y
CONFIG_ZTEST_SUMMARY=n

# enable colored output (see tc_util_user_override.h)
CONFIG_ZTEST_TC_UTIL_USER_OVERRIDE=y

# enable click-able absolute paths in assert messages
CONFIG_BUILD_OUTPUT_STRIP_PATHS=n

CONFIG_COVERAGE=y

# The txt mode test suite may be skipped
CONFIG_ZTEST_VERIFY_RUN_ALL=n
```

## src/common.c
```c
/*
 * Copyright (c) The ThingSet Project Contributors
 *
 * SPDX-License-Identifier: Apache-2.0
 */

#include <zephyr/ztest.h>

#include <thingset.h>

#include "../../src/thingset_internal.h"

#include "data.h"
#include "test_utils.h"

static struct thingset_context ts;

ZTEST(thingset_common, test_endpoint_from_path)
{
    struct thingset_endpoint endpoint;
    char *path;
    int ret;

    path = "";
    ret = thingset_endpoint_by_path(&ts, &endpoint, path, strlen(path));
    zassert_equal(ret, 0);
    zassert_not_equal(endpoint.object, NULL);
    zassert_equal(endpoint.object->id, 0);
    zassert_equal(endpoint.index, THINGSET_ENDPOINT_INDEX_NONE);

    path = "Types";
    ret = thingset_endpoint_by_path(&ts, &endpoint, path, strlen(path));
    zassert_false(ret < 0);
    zassert_not_equal(endpoint.object, NULL);
    zassert_equal(endpoint.object->id, 0x200);
    zassert_equal(endpoint.index, THINGSET_ENDPOINT_INDEX_NONE);

    path = "Types/";
    ret = thingset_endpoint_by_path(&ts, &endpoint, path, strlen(path));
    zassert_false(ret < 0);
    zassert_not_equal(endpoint.object, NULL);
    zassert_equal(endpoint.object->id, 0x200);
    zassert_equal(endpoint.index, THINGSET_ENDPOINT_INDEX_NONE);

    path = "Records";
    ret = thingset_endpoint_by_path(&ts, &endpoint, path, strlen(path));
    zassert_false(ret < 0);
    zassert_not_equal(endpoint.object, NULL);
    zassert_equal(endpoint.object->id, 0x600);
    zassert_equal(endpoint.index, THINGSET_ENDPOINT_INDEX_NONE);

    path = "Records/1";
    ret = thingset_endpoint_by_path(&ts, &endpoint, path, strlen(path));
    zassert_false(ret < 0);
    zassert_not_equal(endpoint.object, NULL);
    zassert_equal(endpoint.object->id, 0x600);
    zassert_equal(endpoint.index, 1);

    path = "Records/-";
    ret = thingset_endpoint_by_path(&ts, &endpoint, path, strlen(path));
    zassert_false(ret < 0);
    zassert_not_equal(endpoint.object, NULL);
    zassert_equal(endpoint.object->id, 0x600);
    zassert_equal(endpoint.index, THINGSET_ENDPOINT_INDEX_NEW);

    path = "Nested/Obj2/rItem1_V";
    ret = thingset_endpoint_by_path(&ts, &endpoint, path, strlen(path));
    zassert_false(ret < 0);
    zassert_not_equal(endpoint.object, NULL);
    zassert_equal(endpoint.object->id, 0x707);
    zassert_equal(endpoint.index, THINGSET_ENDPOINT_INDEX_NONE);

    path = "/";
    ret = thingset_endpoint_by_path(&ts, &endpoint, path, strlen(path));
    zassert_equal(ret, -THINGSET_ERR_NOT_A_GATEWAY);

    path = "Type";
    ret = thingset_endpoint_by_path(&ts, &endpoint, path, strlen(path));
    zassert_equal(ret, -THINGSET_ERR_NOT_FOUND);

    path = "Typess";
    ret = thingset_endpoint_by_path(&ts, &endpoint, path, strlen(path));
    zassert_equal(ret, -THINGSET_ERR_NOT_FOUND);
}

ZTEST(thingset_common, test_serialize_path)
{
    struct thingset_data_object *obj;
    char buf[100];
    int len;

    obj = thingset_get_object_by_id(&ts, 0x10);
    len = thingset_get_path(&ts, buf, sizeof(buf), obj);
    zassert_true(len > 0);
    zassert_mem_equal(buf, "t_s", len);

    obj = thingset_get_object_by_id(&ts, 0x700);
    len = thingset_get_path(&ts, buf, sizeof(buf), obj);
    zassert_true(len > 0);
    zassert_mem_equal(buf, "Nested", len);

    obj = thingset_get_object_by_id(&ts, 0x702);
    len = thingset_get_path(&ts, buf, sizeof(buf), obj);
    zassert_true(len > 0);
    zassert_mem_equal(buf, "Nested/Obj1", len);

    obj = thingset_get_object_by_id(&ts, 0x705);
    len = thingset_get_path(&ts, buf, sizeof(buf), obj);
    zassert_true(len > 0);
    zassert_mem_equal(buf, "Nested/rBetween", len);

    obj = thingset_get_object_by_id(&ts, 0x707);
    len = thingset_get_path(&ts, buf, sizeof(buf), obj);
    zassert_true(len > 0);
    zassert_mem_equal(buf, "Nested/Obj2/rItem1_V", len);
}

/* Paths are not null-terminated, so parsing must not read beyond the given length. */
static char path_without_termination[] = { 'T', 'y', 'p', 'e', 's', '/', 'w', 'B', 'o', 'o', 'l' };

ZTEST(thingset_common, test_endpoint_from_path_without_termination)
{
    struct thingset_endpoint endpoint;
    int err;

    err = thingset_endpoint_by_path(&ts, &endpoint, path_without_termination,
                                    sizeof(path_without_termination));
    zassert_equal(err, 0, "act: 0x%X", -err);
    zassert_equal(endpoint.object->id, 0x201);

    /* a shorter length must select the group instead of the item */
    err = thingset_endpoint_by_path(&ts, &endpoint, path_without_termination, 5);
    zassert_equal(err, 0, "act: 0x%X", -err);
    zassert_equal(endpoint.object->id, 0x200);

    /* an empty path selects the root object */
    err = thingset_endpoint_by_path(&ts, &endpoint, path_without_termination, 0);
    zassert_equal(err, 0, "act: 0x%X", -err);
    zassert_equal(endpoint.object->id, 0);

    /* an empty path must not be dereferenced when looked up directly */
    int index;
    zassert_is_null(thingset_get_object_by_path(&ts, path_without_termination, 0, &index));
}

/* A record index in a path must be limited to the range of valid indices. */
ZTEST(thingset_common, test_endpoint_from_path_record_index)
{
    struct thingset_endpoint endpoint;
    char *path;
    int err;

    path = "Records/1";
    err = thingset_endpoint_by_path(&ts, &endpoint, path, strlen(path));
    zassert_equal(err, 0, "act: 0x%X", -err);
    zassert_equal(endpoint.index, 1);

    path = "Records/65535";
    err = thingset_endpoint_by_path(&ts, &endpoint, path, strlen(path));
    zassert_equal(err, 0, "act: 0x%X", -err);
    zassert_equal(endpoint.index, 65535);

    /* an index above the range of uint16_t must be rejected instead of overflowing */
    path = "Records/65536";
    err = thingset_endpoint_by_path(&ts, &endpoint, path, strlen(path));
    zassert_equal(err, -THINGSET_ERR_NOT_FOUND, "act: 0x%X", -err);

    path = "Records/99999999999999999999";
    err = thingset_endpoint_by_path(&ts, &endpoint, path, strlen(path));
    zassert_equal(err, -THINGSET_ERR_NOT_FOUND, "act: 0x%X", -err);
}

/* Importing a record must reject indices outside of the records array. */
ZTEST(thingset_common, test_import_record_invalid_index)
{
    struct thingset_endpoint endpoint;
    uint8_t data[THINGSET_TEST_BUF_SIZE];
    int err;

    /* {0x602: false} */
    int data_len = hex2bin_spaced("A1 19 06 02 F4", data, sizeof(data));

    err = thingset_endpoint_by_path(&ts, &endpoint, "Records/1", strlen("Records/1"));
    zassert_equal(err, 0, "act: 0x%X", -err);

    /* only two records exist */
    endpoint.index = 2;
    err = thingset_import_record(&ts, data, data_len, &endpoint, THINGSET_BIN_IDS_VALUES);
    zassert_equal(err, -THINGSET_ERR_NOT_FOUND, "act: 0x%X", -err);

    endpoint.index = THINGSET_ENDPOINT_INDEX_NONE;
    err = thingset_import_record(&ts, data, data_len, &endpoint, THINGSET_BIN_IDS_VALUES);
    zassert_equal(err, -THINGSET_ERR_NOT_FOUND, "act: 0x%X", -err);

    /* an endpoint that is not a records object must be rejected as well */
    err = thingset_endpoint_by_path(&ts, &endpoint, "Types", strlen("Types"));
    zassert_equal(err, 0, "act: 0x%X", -err);
    endpoint.index = 0;
    err = thingset_import_record(&ts, data, data_len, &endpoint, THINGSET_BIN_IDS_VALUES);
    zassert_equal(err, -THINGSET_ERR_NOT_FOUND, "act: 0x%X", -err);
}

/* Dynamic records keep only one record in memory, so the index must not be used as an offset. */
ZTEST(thingset_common, test_import_dyn_record)
{
    struct thingset_endpoint endpoint;
    uint8_t data[THINGSET_TEST_BUF_SIZE];
    int err;

    /* {0x681: 42} */
    int data_len = hex2bin_spaced("A1 19 06 81 18 2A", data, sizeof(data));

    err = thingset_endpoint_by_path(&ts, &endpoint, "DynRecords/7", strlen("DynRecords/7"));
    zassert_equal(err, 0, "act: 0x%X", -err);
    zassert_equal(endpoint.index, 7);

    err = thingset_import_record(&ts, data, data_len, &endpoint, THINGSET_BIN_IDS_VALUES);
    zassert_equal(err, 0, "act: 0x%X", -err);

    zassert_equal(dyn_records.index, 42);

    dyn_records.index = 0;
}

/* Rejecting an unsupported format must not leave the context locked. */
ZTEST(thingset_common, test_export_subsets_unsupported_format)
{
    uint8_t buf[THINGSET_TEST_BUF_SIZE];
    int err;

    err = thingset_export_subsets(&ts, buf, sizeof(buf), SUBSET_LIVE, THINGSET_BIN_IDS_ONLY);
    zassert_equal(err, -THINGSET_ERR_NOT_IMPLEMENTED, "act: 0x%X", -err);

    /* a leaked lock would make this time out and fail with an internal server error */
    err = thingset_export_subsets(&ts, buf, sizeof(buf), SUBSET_LIVE, THINGSET_BIN_IDS_VALUES);
    zassert_true(err > 0, "act: 0x%X", -err);
}

static void *thingset_setup(void)
{
    thingset_init_global(&ts);

    return NULL;
}

ZTEST_SUITE(thingset_common, NULL, thingset_setup, NULL, NULL, NULL);
```

## src/elemental_array_reports.c
```c
/*
 * Copyright (c) The ThingSet Project Contributors
 *
 * SPDX-License-Identifier: Apache-2.0
 */

#include <zephyr/ztest.h>

#include <thingset.h>

#include "../../src/thingset_internal.h"

#include "test_utils.h"
#include "data.h"

static struct thingset_context ts;

struct object_callback_data {
    char **expected_hex;
    int *expected_size;
    int num_messages;
    int expected_num_messages;
};

static int object_callback(struct thingset_data_object *obj, void *callback_context)
{
    if (obj->type == THINGSET_TYPE_ARRAY_ELEMENT) {
        uint8_t buffer[THINGSET_TEST_BUF_SIZE];
        struct object_callback_data *data = (struct object_callback_data *)callback_context;
        int data_len = thingset_export_item(&ts, buffer, THINGSET_TEST_BUF_SIZE, obj, THINGSET_BIN_VALUES_ONLY);
        zassert_false(data_len < 0);
        zassert_true(data_len < 8);
        char *expected_hex = data->expected_hex[data->num_messages];
        uint8_t expected[THINGSET_TEST_BUF_SIZE];
        int exp_len = data->expected_size[data->num_messages];
        hex2bin_spaced(expected_hex, expected, exp_len);
        zassert_equal(exp_len, data_len);
        zassert_mem_equal(expected, buffer, exp_len);
        data->num_messages++;
    }
    return 0;
}

ZTEST(thingset_elemental_array_reports, test_serialize_float_array)
{
    char* expected_hex[3];
    expected_hex[0] = "82 00 FA BF 8C CC CD"; /* -1.1 */
    expected_hex[1] = "82 01 FA C0 0C CC CD"; /* -2.2 */
    expected_hex[2] = "82 02 FA C0 53 33 33"; /* -3.3 */

    int expected_sizes[] = { 7, 7, 7 };
    struct object_callback_data data = {
        .expected_hex = expected_hex,
        .expected_size = expected_sizes,
        .expected_num_messages = 3,
    };
    ts.elementwise_array_updates = true;
    int ret = thingset_for_object_in_subsets(&ts, SUBSET_ELEM_ARRAY_LIVE, object_callback, &data);
    ts.elementwise_array_updates = false;
    zassert_false(ret < 0);
    zassert_equal(3, data.num_messages, "Expected %d; was %d", 3, data.num_messages);
}

ZTEST(thingset_elemental_array_reports, test_deserialize_float_array_into_record)
{
    struct thingset_endpoint endpoint;
    uint8_t buffer[THINGSET_TEST_BUF_SIZE];
    int err;

    char* report_hex[3];
    report_hex[0] = "A1 19 06 0F 82 00 FA 3F 8C CC CD";
    report_hex[1] = "A1 19 06 0F 82 01 FA 40 0C CC CD";
    report_hex[2] = "A1 19 06 0F 82 02 FA 40 53 33 33";

    float original_float[3] = { 1.23F, 4.56F, 7.89F };
    float expected_float[3] = { 1.1F, 2.2F, 3.3F };

    err = thingset_endpoint_by_path(&ts, &endpoint, "Records/1", strlen("Records/1"));
    zassert_equal(err, 0);

    for (int i = 0; i < 3; i++)
    {
        zassert_equal(records[1].f32_arr[i], original_float[i]);
        hex2bin_spaced(report_hex[i], buffer, 11);
        ts.elementwise_array_updates = true;
        err = thingset_import_record(&ts, buffer, 11, &endpoint, THINGSET_BIN_IDS_VALUES);
        ts.elementwise_array_updates = false;
        zassert_equal(records[1].f32_arr[i], expected_float[i]);
        zassert_equal(err, 0);
    }

    for (int i = 0; i < 3; i++)
    {
        records[1].f32_arr[i] = original_float[i];
    }
}

static void *thingset_setup(void)
{
    thingset_init_global(&ts);

    return NULL;
}

ZTEST_SUITE(thingset_elemental_array_reports, NULL, thingset_setup, NULL, NULL, NULL);
```

## src/init.c
```c
/*
 * Copyright (c) The ThingSet Project Contributors
 *
 * SPDX-License-Identifier: Apache-2.0
 */

#include <zephyr/ztest.h>

#include <thingset.h>

extern struct thingset_data_object data_objects[];
extern size_t data_objects_size;

ZTEST(thingset_init, test_init_data_objects)
{
    struct thingset_global_context ts_local;
    struct thingset_global_context ts_global;

    /* initialized with array declared in data.c */
    thingset_init(&ts_local, data_objects, data_objects_size);

    /* initialized using Zephyr iterable sections */
    thingset_init_global(&ts_global);

    zassert_equal(ts_local.num_objects, data_objects_size);
    zassert_equal(ts_global.num_objects, data_objects_size);

    if (IS_ENABLED(CONFIG_THINGSET_OBJECT_LOOKUP_MAP)) {
        for (unsigned int i = 0; i < ts_local.num_objects; i++) {
            struct thingset_data_object local = ts_local.data_objects[i];
            struct thingset_data_object global = ts_global.data_objects[i];
            /* find size of object excluding pointer conveniently at the end */
            size_t size = sizeof(struct thingset_data_object) - sizeof(sys_snode_t);
            zassert_mem_equal(&local, &global, size);
        }
    }
    else {
        zassert_mem_equal(ts_local.data_objects, ts_global.data_objects,
                          data_objects_size * sizeof(struct thingset_data_object));
    }
}

ZTEST_SUITE(thingset_init, NULL, NULL, NULL, NULL, NULL);
```

## src/txt.c
```c
/*
 * Copyright (c) The ThingSet Project Contributors
 *
 * SPDX-License-Identifier: Apache-2.0
 */

#include <zephyr/ztest.h>

#include <math.h>

#include <thingset.h>

#include "data.h"
#include "test_utils.h"

static struct thingset_context ts;

bool update_callback_called;

void update_callback(void)
{
    update_callback_called = true;
}

ZTEST(thingset_txt, test_get_root)
{
    const char req[] = "?";
    const char rsp_exp[] =
        ":85 {"
        "\"t_s\":1000,"
        "\"cNodeID\":\"ABCD1234\","
        "\"Types\":null,"
        "\"Arrays\":null,"
        "\"Exec\":null,"
        "\"Access\":null,"
        "\"Records\":2,"
        "\"DynRecords\":10,"
        "\"Nested\":null,"
        "\"mLive\":[\"t_s\",\"Types/wBool\",\"Records\",\"Nested/rBeginning\",\"Nested/Obj2/"
        "rItem2_V\"]"
        "}";

    THINGSET_ASSERT_REQUEST_TXT(req, rsp_exp);
}

ZTEST(thingset_txt, test_get_nested)
{
    const char req[] = "?Nested";
    const char rsp_exp[] =
        ":85 {"
        "\"rBeginning\":1,"
        "\"Obj1\":null,"
        "\"rBetween\":2,"
        "\"Obj2\":null,"
        "\"rEnd\":3"
        "}";

    THINGSET_ASSERT_REQUEST_TXT(req, rsp_exp);
}

ZTEST(thingset_txt, test_get_single_value)
{
    const char req[] = "?Nested/Obj1/rItem2_V";
    const char rsp_exp[] = ":85 1.2";

    THINGSET_ASSERT_REQUEST_TXT(req, rsp_exp);
}

ZTEST(thingset_txt, test_get_exec)
{
    const char req[] = "?Exec";
    const char rsp_exp[] =
        ":85 {"
        "\"xVoid\":[],"
        "\"xVoidParams\":[\"lBool\"],"
        "\"xI32Params\":[\"uString\",\"nNumber\"],"
        "\"xVoidMfrOnly\":[]"
        "}";

    THINGSET_ASSERT_REQUEST_TXT(req, rsp_exp);
}

ZTEST(thingset_txt, test_get_num_records)
{
    THINGSET_ASSERT_REQUEST_TXT("?Records", ":85 2");
}

ZTEST(thingset_txt, test_get_record)
{
    const char req[] = "?Records/1";
    const char rsp_exp[] =
        ":85 {"
        "\"t_s\":2,"
        "\"wBool\":true,"
        "\"wU8\":8,\"wI8\":-8,"
        "\"wU16\":16,\"wI16\":-16,"
        "\"wU32\":32,\"wI32\":-32,"
        "\"wU64\":64,\"wI64\":-64,"
        "\"wF32\":-3.2,\"wDecFrac\":-32e-2,"
        "\"wString\":\"string\","
        "\"wF32Array\":[1.2,4.6,7.9],"
        "\"Nested\":2"
        "}";

    THINGSET_ASSERT_REQUEST_TXT(req, rsp_exp);
}

ZTEST(thingset_txt, test_get_dyn_record)
{
    const char req[] = "?DynRecords/7";
    const char rsp_exp[] = ":85 {\"rIndex\":7}";

    dyn_records_callback_pre_read_count = 0;
    dyn_records_callback_post_read_count = 0;
    dyn_records_callback_index = 0;

    THINGSET_ASSERT_REQUEST_TXT(req, rsp_exp);

    zassert_equal(dyn_records_callback_pre_read_count, 1);
    zassert_equal(dyn_records_callback_post_read_count, 1);
    zassert_equal(dyn_records_callback_index, 7);
}

ZTEST(thingset_txt, test_fetch_root_names)
{
    const char req[] = "? null";
    const char rsp_exp[] =
        ":85 ["
        "\"t_s\","
        "\"cNodeID\","
        "\"Types\","
        "\"Arrays\","
        "\"Exec\","
        "\"Access\","
        "\"Records\","
        "\"DynRecords\","
        "\"Nested\","
        "\"mLive\""
        "]";

    THINGSET_ASSERT_REQUEST_TXT(req, rsp_exp);
}

ZTEST(thingset_txt, test_fetch_nested_names)
{
    const char req[] = "?Nested null";
    const char rsp_exp[] =
        ":85 ["
        "\"rBeginning\","
        "\"Obj1\","
        "\"rBetween\","
        "\"Obj2\","
        "\"rEnd\""
        "]";

    THINGSET_ASSERT_REQUEST_TXT(req, rsp_exp);
}

ZTEST(thingset_txt, test_fetch_node_id)
{
    const char req[] = "? [\"cNodeID\"]";
    const char rsp_exp[] = ":85 [\"ABCD1234\"]";

    THINGSET_ASSERT_REQUEST_TXT(req, rsp_exp);
}

ZTEST(thingset_txt, test_fetch_bad_elem)
{
    const char req[] = "? [true]";
    const char rsp_exp[] = ":A0";

    THINGSET_ASSERT_REQUEST_TXT(req, rsp_exp);
}

ZTEST(thingset_txt, test_fetch_not_found)
{
    const char req[] = "? [\"foo\"]";
    const char rsp_exp[] = ":A4";

    THINGSET_ASSERT_REQUEST_TXT(req, rsp_exp);
}

ZTEST(thingset_txt, test_fetch_group)
{
    const char req[] = "? [\"Nested\"]";
    const char rsp_exp[] = ":A0 \"Nested is a group\"";

    THINGSET_ASSERT_REQUEST_TXT(req, rsp_exp);
}

/*
 * A request with more tokens than CONFIG_THINGSET_NUM_JSON_TOKENS must be rejected without
 * writing past the end of the token array in the ThingSet context.
 */
ZTEST(thingset_txt, test_fetch_too_many_json_tokens)
{
    char req[THINGSET_TEST_BUF_SIZE];
    int pos = snprintf(req, sizeof(req), "?Access [");

    /* jsmn counts the array itself as a token, so this is one token too many */
    for (unsigned int i = 0; i < CONFIG_THINGSET_NUM_JSON_TOKENS; i++) {
        pos += snprintf(req + pos, sizeof(req) - pos, i > 0 ? ",0" : "0");
    }
    pos += snprintf(req + pos, sizeof(req) - pos, "]");

    zassert_true(pos < sizeof(req), "test request does not fit into buffer");

    THINGSET_ASSERT_REQUEST_TXT(req, ":AD \"JSON parsing error\"");
}

ZTEST(thingset_txt, test_fetch_multiple)
{
    THINGSET_ASSERT_REQUEST_TXT("?Types [\"wF32\",\"wBool\",\"wU32\"]", ":85 [-3.20,true,32]");
}

ZTEST(thingset_txt, test_fetch_rounded)
{
    float bak = f32;
    f32 = 3.115;

    THINGSET_ASSERT_REQUEST_TXT("?Types [\"wF32\"]", ":85 [3.12]");

    f32 = bak;
}

ZTEST(thingset_txt, test_fetch_nan)
{
    float bak = f32;
    uint32_t nan = 0x7F800001;
    f32 = *(float *)&nan;

    zassert_true(isnan(f32));
    THINGSET_ASSERT_REQUEST_TXT("?Types [\"wF32\"]", ":85 [null]");

    f32 = bak;
}

ZTEST(thingset_txt, test_fetch_inf)
{
    float bak = f32;
    uint32_t inf = 0x7F800000;
    f32 = *(float *)&inf;

    THINGSET_ASSERT_REQUEST_TXT("?Types [\"wF32\"]", ":85 [null]");

    f32 = bak;
}

ZTEST(thingset_txt, test_fetch_int32_array)
{
    THINGSET_ASSERT_REQUEST_TXT("?Arrays [\"wI32\"]", ":85 [[-1,-2,-3]]");
}

ZTEST(thingset_txt, test_fetch_float_array)
{
    THINGSET_ASSERT_REQUEST_TXT("?Arrays [\"wF32\"]", ":85 [[-1.1,-2.2,-3.3]]");
}

#ifdef CONFIG_THINGSET_METADATA_ENDPOINT

ZTEST(thingset_txt, test_fetch_metadata)
{
    THINGSET_ASSERT_REQUEST_TXT("?_Metadata [\"Arrays/wF32\"]",
                                ":85 [{\"name\":\"wF32\",\"type\":\"f32[]\"}]");
}

#endif /* CONFIG_THINGSET_METADATA_ENDPOINT */

#if CONFIG_THINGSET_JSON_STRING_ESCAPING

ZTEST(thingset_txt, test_fetch_escaped_string)
{
    strcpy(strbuf, "\n\"\\");

    THINGSET_ASSERT_REQUEST_TXT("?Types/wString", ":85 \"\\n\\\"\\\\\"");

    /* reset to default again */
    strcpy(strbuf, "string");
}

ZTEST(thingset_txt, test_update_escaped_string)
{
    const char str_exp[] = "\n\"\\";

    memset(strbuf, 0, 10);

    THINGSET_ASSERT_REQUEST_TXT("=Types {\"wString\":\"\\n\\\"\\\\\"}", ":84");

    zassert_mem_equal(strbuf, str_exp, sizeof(str_exp));

    /* reset to default again */
    strcpy(strbuf, "string");
}

#endif /* CONFIG_THINGSET_JSON_STRING_ESCAPING */

/*
 * Process the request with a response buffer of the given size, which is followed by a guard
 * pattern to detect writes beyond the end of the buffer.
 */
static void assert_response_within_buffer(const char *req, size_t rsp_size)
{
    uint8_t buf[THINGSET_TEST_BUF_SIZE];
    const uint8_t guard = 0xAA;

    memset(buf, guard, sizeof(buf));

    int len = thingset_process_message(&ts, req, strlen(req), buf, rsp_size);

    for (size_t i = rsp_size; i < sizeof(buf); i++) {
        if (buf[i] != guard) {
            zassert_unreachable("req \"%s\" with buffer size %u wrote %u bytes beyond the end", req,
                                (unsigned int)rsp_size, (unsigned int)(i - rsp_size + 1));
        }
    }

    zassert_true(len <= (int)rsp_size, "req \"%s\" returned %d for a buffer size of %u", req, len,
                 (unsigned int)rsp_size);
}

/* Serializing into a buffer that is too small must not write beyond the end of the buffer. */
ZTEST(thingset_txt, test_serialize_buffer_too_small)
{
    static const char *const reqs[] = {
        "?Arrays/wF32",   /* array */
        "?mLive",         /* subset of paths */
        "?Exec",          /* group containing functions */
        "?Types/wString", /* string */
        "?Types",         /* group of simple values */
        "?Records/1",     /* record */
        "?",              /* whole node */
    };

    for (unsigned int i = 0; i < ARRAY_SIZE(reqs); i++) {
        /* 4 bytes is the minimum size accepted by thingset_process_message() */
        for (size_t size = 4; size <= 128; size++) {
            assert_response_within_buffer(reqs[i], size);
        }
    }
}

ZTEST(thingset_txt, test_update_timestamp_zero)
{
    THINGSET_ASSERT_REQUEST_TXT("= {\"t_s\":0}", ":84");
    zassert_equal(timestamp, 0);

    timestamp = 1000;
}

ZTEST(thingset_txt, test_update_wrong_data_structure)
{
    THINGSET_ASSERT_REQUEST_TXT("=Types [\"wF32\":54.3", ":A0 \"JSON parsing error\"");
    THINGSET_ASSERT_REQUEST_TXT("=Types{\"wF32\":54.3}", ":A4 \"Invalid endpoint\"");
}

ZTEST(thingset_txt, test_update_whitespaces)
{
    THINGSET_ASSERT_REQUEST_TXT("=Types {    \"wF32\" : 52.8,\"wI32\":50.6}", ":84");

    zassert_equal((float)52.8, f32);
    zassert_equal(50, i32);

    f32 = -3.2F;
    i32 = -32;
}

#if CONFIG_THINGSET_BYTES_TYPE_SUPPORT

ZTEST(thingset_txt, test_update_bytes_buffer)
{
    THINGSET_ASSERT_REQUEST_TXT("=Types {\"wBytes\":\"QUJDREVGRw==\"}", ":84");

    zassert_equal(7, bytes_item.num_bytes);
}

#else

ZTEST(thingset_txt, test_update_bytes_buffer)
{
    THINGSET_ASSERT_REQUEST_TXT("=Types {\"wBytes\":\"QUJDREVGRw==\"}", ":AF");
}

#endif

ZTEST(thingset_txt, test_update_readonly)
{
    THINGSET_ASSERT_REQUEST_TXT("=Access {\"rItem\" : 52}", ":A3 \"Item rItem is read-only\"");
}

ZTEST(thingset_txt, test_update_wrong_path)
{
    THINGSET_ASSERT_REQUEST_TXT("=Type {\"wI32\" : 52}", ":A4 \"Invalid endpoint\"");
}

ZTEST(thingset_txt, test_update_unknown_object)
{
    THINGSET_ASSERT_REQUEST_TXT("=Types {\"wI3\" : 52}", ":A4");
}

ZTEST(thingset_txt, test_update_int32_array)
{
    THINGSET_ASSERT_REQUEST_TXT("=Arrays {\"wI32\":[1,2,3]}", ":84");

    zassert_equal(i32_arr[0], 1);
    zassert_equal(i32_arr[1], 2);
    zassert_equal(i32_arr[2], 3);

    i32_arr[0] = -1;
    i32_arr[1] = -2;
    i32_arr[2] = -3;
}

ZTEST(thingset_txt, test_update_float_array)
{
    THINGSET_ASSERT_REQUEST_TXT("=Arrays {\"wF32\":[1.1,2.2,3.3]}", ":84");

    zassert_equal(f32_arr[0], (float)1.1);
    zassert_equal(f32_arr[1], (float)2.2);
    zassert_equal(f32_arr[2], (float)3.3);

    f32_arr[0] = -1.1;
    f32_arr[1] = -2.2;
    f32_arr[2] = -3.3;
}

ZTEST(thingset_txt, test_group_callback)
{
    group_callback_pre_read_count = 0;
    group_callback_post_read_count = 0;
    group_callback_pre_write_count = 0;
    group_callback_post_write_count = 0;

    THINGSET_ASSERT_REQUEST_TXT("=Access {\"wItem\":1}", ":84");

    zassert_equal(group_callback_pre_read_count, 0);
    zassert_equal(group_callback_post_read_count, 0);
    zassert_equal(group_callback_pre_write_count, 1);
    zassert_equal(group_callback_post_write_count, 1);

    THINGSET_ASSERT_REQUEST_TXT("?Access", ":85 {\"rItem\":1.00,\"wItem\":1.00,\"wMfrOnly\":1.00}");

    zassert_equal(group_callback_pre_read_count, 1);
    zassert_equal(group_callback_post_read_count, 1);
    zassert_equal(group_callback_pre_write_count, 1);
    zassert_equal(group_callback_post_write_count, 1);

    THINGSET_ASSERT_REQUEST_TXT("?Access [\"wItem\"]", ":85 [1.00]");

    zassert_equal(group_callback_pre_read_count, 2);
    zassert_equal(group_callback_post_read_count, 2);
    zassert_equal(group_callback_pre_write_count, 1);
    zassert_equal(group_callback_post_write_count, 1);

    THINGSET_ASSERT_REQUEST_TXT("?Access/wItem", ":85 1.00");

    zassert_equal(group_callback_pre_read_count, 3);
    zassert_equal(group_callback_post_read_count, 3);
    zassert_equal(group_callback_pre_write_count, 1);
    zassert_equal(group_callback_post_write_count, 1);
}

ZTEST(thingset_txt, test_exec_fn_void)
{
    fn_void_called = false;

    THINGSET_ASSERT_REQUEST_TXT("!Exec/xVoid", ":84");

    zassert_equal(true, fn_void_called);
}

ZTEST(thingset_txt, test_exec_fn_void_mfr_only)
{
    THINGSET_ASSERT_REQUEST_TXT("!Exec/xVoidMfrOnly", ":A1 \"Authentication required\"");
}

ZTEST(thingset_txt, test_exec_fn_void_params)
{
    fn_void_params_called = false;
    fn_void_param_b = false;

    THINGSET_ASSERT_REQUEST_TXT("!Exec/xVoidParams [true]", ":84");

    zassert_equal(true, fn_void_params_called);
    zassert_equal(true, fn_void_param_b);
}

ZTEST(thingset_txt, test_exec_fn_void_invalid_json)
{
    THINGSET_ASSERT_REQUEST_TXT("!Exec/xVoidParams [true", ":A0 \"JSON parsing error\"");
}

ZTEST(thingset_txt, test_exec_fn_void_invalid_params)
{
    THINGSET_ASSERT_REQUEST_TXT("!Exec/xVoidParams true", ":A0 \"Invalid parameters\"");
}

ZTEST(thingset_txt, test_exec_fn_void_too_many_params)
{
    THINGSET_ASSERT_REQUEST_TXT("!Exec/xVoidParams [true, 123]", ":A0 \"Too many parameters\"");
}

ZTEST(thingset_txt, test_exec_fn_void_not_enough_params)
{
    THINGSET_ASSERT_REQUEST_TXT("!Exec/xVoidParams", ":A0 \"Not enough parameters\"");
}

ZTEST(thingset_txt, test_exec_fn_void_wrong_params)
{
    THINGSET_ASSERT_REQUEST_TXT("!Exec/xVoidParams [\"wrong\"]", ":AF");
}

ZTEST(thingset_txt, test_exec_fn_not_executable)
{
    THINGSET_ASSERT_REQUEST_TXT("!Access/rItem", ":A3 \"rItem is not executable\"");
}

ZTEST(thingset_txt, test_exec_fn_int32)
{
    fn_i32_param_str[0] = '\0';
    fn_i32_param_num = 0;

    THINGSET_ASSERT_REQUEST_TXT("!Exec/xI32Params [\"test\",123]", ":84 -1");

    zassert_mem_equal("test", fn_i32_param_str, 4);
    zassert_equal(123, fn_i32_param_num);
}

ZTEST(thingset_txt, test_create_delete_subset_item)
{
    /* before change */
    THINGSET_ASSERT_REQUEST_TXT(
        "?mLive",
        ":85 [\"t_s\",\"Types/wBool\",\"Records\",\"Nested/rBeginning\",\"Nested/Obj2/rItem2_V\"]");

    /* delete "Types/wBool" */
    THINGSET_ASSERT_REQUEST_TXT("-mLive \"Types/wBool\"", ":82");

    /* check if it was deleted */
    THINGSET_ASSERT_REQUEST_TXT(
        "?mLive", ":85 [\"t_s\",\"Records\",\"Nested/rBeginning\",\"Nested/Obj2/rItem2_V\"]");

    /* append "Types/wBool" again */
    THINGSET_ASSERT_REQUEST_TXT("+mLive \"Types/wBool\"", ":81");

    /* check if it was appended */
    THINGSET_ASSERT_REQUEST_TXT(
        "?mLive",
        ":85 [\"t_s\",\"Types/wBool\",\"Records\",\"Nested/rBeginning\",\"Nested/Obj2/rItem2_V\"]");
}

ZTEST(thingset_txt, test_create_root_item)
{
    THINGSET_ASSERT_REQUEST_TXT("+ \"Test\"", ":A0 \"Endpoint item required\"");
}

ZTEST(thingset_txt, test_create_multiple_values)
{
    THINGSET_ASSERT_REQUEST_TXT("+mLive [\"Types/wBool\",\"Types/wI32\"]", ":AF");
}

ZTEST(thingset_txt, test_create_non_existing_item)
{
    THINGSET_ASSERT_REQUEST_TXT("+mLive \"Types/wBoo\"", ":A4");
}

ZTEST(thingset_txt, test_create_wrong_type_item)
{
    THINGSET_ASSERT_REQUEST_TXT("+mLive 123", ":AF");
}

ZTEST(thingset_txt, test_create_array_item)
{
    THINGSET_ASSERT_REQUEST_TXT("+Arrays/wBool/- true", ":C1 \"Arrays not yet supported\"");
}

ZTEST(thingset_txt, test_create_single_value)
{
    THINGSET_ASSERT_REQUEST_TXT("+Types/wBool true", ":A5");
}

ZTEST(thingset_txt, test_create_non_existing_endpoint)
{
    THINGSET_ASSERT_REQUEST_TXT("+foo 1", ":A4 \"Invalid endpoint\"");
}

ZTEST(thingset_txt, test_desire_timestamp_zero)
{
    const char des[] = "@t_s 0";
    const int err_exp = -THINGSET_ERR_NOT_IMPLEMENTED;

    THINGSET_ASSERT_DESIRE_TXT(des, err_exp);
}

ZTEST(thingset_txt, test_report_subset)
{
    const char rpt_exp[] =
        "#mLive {"
        "\"t_s\":1000,"
        "\"Types\":{\"wBool\":true},"
        "\"Records\":2,"
        "\"Nested\":{\"rBeginning\":1,\"Obj2\":{\"rItem2_V\":2.2}}"
        "}";

    THINGSET_ASSERT_REPORT_TXT("mLive", rpt_exp, strlen(rpt_exp));
}

ZTEST(thingset_txt, test_report_group)
{
    const char rpt_exp[] =
        "#Nested/Obj1 {"
        "\"rItem1_V\":1.1,"
        "\"rItem2_V\":1.2"
        "}";

    THINGSET_ASSERT_REPORT_TXT("Nested/Obj1", rpt_exp, strlen(rpt_exp));
}

ZTEST(thingset_txt, test_report_record)
{
    const char rpt_exp[] =
        "#Records/1 {"
        "\"t_s\":2,"
        "\"wBool\":true,"
        "\"wU8\":8,\"wI8\":-8,"
        "\"wU16\":16,\"wI16\":-16,"
        "\"wU32\":32,\"wI32\":-32,"
        "\"wU64\":64,\"wI64\":-64,"
        "\"wF32\":-3.2,\"wDecFrac\":-32e-2,"
        "\"wString\":\"string\","
        "\"wF32Array\":[1.2,4.6,7.9],"
        "\"Nested\":2"
        "}";

    THINGSET_ASSERT_REPORT_TXT("Records/1", rpt_exp, strlen(rpt_exp));
}

ZTEST(thingset_txt, test_report_dyn_record)
{
    const char rpt_exp[] = "#DynRecords/3 {\"rIndex\":3}";

    dyn_records_callback_pre_read_count = 0;
    dyn_records_callback_post_read_count = 0;
    dyn_records_callback_index = 0;

    THINGSET_ASSERT_REPORT_TXT("DynRecords/3", rpt_exp, strlen(rpt_exp));

    zassert_equal(dyn_records_callback_pre_read_count, 1);
    zassert_equal(dyn_records_callback_post_read_count, 1);
    zassert_equal(dyn_records_callback_index, 3);
}

ZTEST(thingset_txt, test_export_subset)
{
    const char rsp_exp[] =
        "{"
        "\"t_s\":1000,"
        "\"Types\":{\"wBool\":true},"
        "\"Records\":2,"
        "\"Nested\":{\"rBeginning\":1,\"Obj2\":{\"rItem2_V\":2.2}}"
        "}";

    THINGSET_ASSERT_EXPORT_TXT(SUBSET_LIVE, rsp_exp, strlen(rsp_exp));
}

ZTEST(thingset_txt, test_update_callback)
{
    update_callback_called = false;

    /* without callback */
    thingset_set_update_callback(&ts, SUBSET_NVM, NULL);
    THINGSET_ASSERT_REQUEST_TXT("=Access {\"wItem\":1}", ":84");
    zassert_equal(false, update_callback_called);

    /* with configured callback */
    thingset_set_update_callback(&ts, SUBSET_NVM, update_callback);
    THINGSET_ASSERT_REQUEST_TXT("=Access {\"wItem\":1}", ":84");
    zassert_equal(true, update_callback_called);
}

ZTEST(thingset_txt, test_auth)
{
    /* before authentication */
    thingset_set_authentication(&ts, THINGSET_USR_MASK);
    THINGSET_ASSERT_REQUEST_TXT("=Access {\"wMfrOnly\":1}",
                                ":A1 \"Authentication required for wMfrOnly\"");
    THINGSET_ASSERT_REQUEST_TXT("!Exec/xVoidMfrOnly", ":A1 \"Authentication required\"");

    /* after authentication */
    thingset_set_authentication(&ts, THINGSET_USR_MASK | THINGSET_MFR_MASK);
    THINGSET_ASSERT_REQUEST_TXT("=Access {\"wItem\":1}", ":84");
    THINGSET_ASSERT_REQUEST_TXT("!Exec/xVoidMfrOnly", ":84");

    /* reset authentication */
    thingset_set_authentication(&ts, THINGSET_USR_MASK);
}

ZTEST(thingset_txt, test_import_record)
{
    struct thingset_endpoint endpoint;
    int err;

    char *data = "{\"wBool\":false}";

    err = thingset_endpoint_by_path(&ts, &endpoint, "Records/1", strlen("Records/1"));
    zassert_equal(err, 0);

    zassert_equal(records[1].b, true);

    err = thingset_import_record(&ts, data, strlen(data), &endpoint, THINGSET_TXT_NAMES_VALUES);
    zassert_equal(err, 0, "act: 0x%X", -err);

    zassert_equal(records[1].b, false);

    records[1].b = true;
}

static bool thingset_txt_predicate(const void *global_state)
{
    return IS_ENABLED(CONFIG_THINGSET_TEXT_MODE);
}

static void *thingset_setup(void)
{
    thingset_init_global(&ts);

    return NULL;
}

ZTEST_SUITE(thingset_txt, thingset_txt_predicate, thingset_setup, NULL, NULL, NULL);
```
